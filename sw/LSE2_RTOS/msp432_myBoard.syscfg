/**
 * @cliArgs --board "/ti/boards/MSP_EXP432E401Y" --product "simplelink_msp432e4_sdk@4.20.00.12"
 * @versions {"data":"2020050718","timestamp":"2020050718","tool":"1.5.0+1353","templates":"2020050718"}
 */

/**
 * Import the modules used in this configuration.
 */
const GPIO  = scripting.addModule("/ti/drivers/GPIO", {}, false);
const GPIO1 = GPIO.addInstance();
const GPIO2 = GPIO.addInstance();
const GPIO3 = GPIO.addInstance();
const GPIO4 = GPIO.addInstance();
const GPIO5 = GPIO.addInstance();
const GPIO6 = GPIO.addInstance();
const GPIO7 = GPIO.addInstance();
const I2C   = scripting.addModule("/ti/drivers/I2C", {}, false);
const I2C1  = I2C.addInstance();
const Power = scripting.addModule("/ti/drivers/Power");
const RTOS  = scripting.addModule("/ti/drivers/RTOS");
const SPI   = scripting.addModule("/ti/drivers/SPI", {}, false);
const SPI1  = SPI.addInstance();
const UART  = scripting.addModule("/ti/drivers/UART", {}, false);
const UART1 = UART.addInstance();

/**
 * Write custom configuration values to the imported modules.
 */
GPIO1.$name     = "CONFIG_GPIO_0";
GPIO1.$hardware = system.deviceData.board.components.D1;

GPIO2.$name     = "CONFIG_GPIO_1";
GPIO2.$hardware = system.deviceData.board.components.D2;

GPIO3.$name           = "SS_R";
GPIO3.mode            = "Output";
GPIO3.gpioPin.$assign = "boosterpack2.10";

GPIO4.$name           = "SS_L";
GPIO4.mode            = "Output";
GPIO4.gpioPin.$assign = "boosterpack2.30";

GPIO5.$name           = "SS_RF";
GPIO5.mode            = "Output";
GPIO5.pull            = "Pull Down";
GPIO5.gpioPin.$assign = "boosterpack2.36";

GPIO6.$name           = "CE_RF";
GPIO6.mode            = "Output";
GPIO6.gpioPin.$assign = "boosterpack2.35";

GPIO7.$name            = "INT_RF";
GPIO7.pull             = "Pull Up";
GPIO7.interruptTrigger = "Falling Edge";
GPIO7.gpioPin.$assign  = "boosterpack.30";

I2C1.$name              = "CONFIG_I2C_0";
I2C1.i2c.$assign        = "I2C5";
I2C1.i2c.sdaPin.$assign = "boosterpack2.24";


SPI1.$name               = "CONFIG_SPI_0";
SPI1.spi.$assign         = "SSI3";
SPI1.spi.sclkPin.$assign = "boosterpack2.7";
SPI1.spi.misoPin.$assign = "boosterpack2.14";
SPI1.spi.mosiPin.$assign = "boosterpack2.15";

UART1.$name     = "CONFIG_UART_0";
UART1.$hardware = system.deviceData.board.components.XDS110UART;

/**
 * Pinmux solution for unlocked pins/peripherals. This ensures that minor changes to the automatic solver in a future
 * version of the tool will not impact the pinmux you originally saw.  These lines can be completely deleted in order to
 * re-solve from scratch.
 */
GPIO1.gpioPin.$suggestSolution         = "expansion.87";
GPIO2.gpioPin.$suggestSolution         = "expansion.85";
I2C1.i2c.sclPin.$suggestSolution       = "boosterpack2.23";
RTOS.timer0.resource.$suggestSolution  = "Timer0";
SPI1.spi.dmaRxChannel.$suggestSolution = "UDMA_CH14";
SPI1.spi.dmaTxChannel.$suggestSolution = "UDMA_CH15";
UART1.uart.$suggestSolution            = "UART0";
UART1.uart.txPin.$suggestSolution      = "expansion.76";
UART1.uart.rxPin.$suggestSolution      = "expansion.74";
