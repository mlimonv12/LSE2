/**
 * @cliArgs --board "/ti/boards/MSP_EXP432E401Y" --product "simplelink_msp432e4_sdk@4.20.00.12"
 * @versions {"data":"2020050718","timestamp":"2020050718","tool":"1.5.0+1353","templates":"2020050718"}
 */

/**
 * Import the modules used in this configuration.
 */
const GPIO    = scripting.addModule("/ti/drivers/GPIO", {}, false);
const GPIO1   = GPIO.addInstance();
const GPIO2   = GPIO.addInstance();
const Power   = scripting.addModule("/ti/drivers/Power");
const RTOS    = scripting.addModule("/ti/drivers/RTOS");
const Button  = scripting.addModule("/ti/drivers/apps/Button", {}, false);
const Button1 = Button.addInstance();

/**
 * Write custom configuration values to the imported modules.
 */
GPIO1.$name     = "CONFIG_GPIO_0";
GPIO1.$hardware = system.deviceData.board.components.D1;

GPIO2.$name     = "CONFIG_GPIO_1";
GPIO2.$hardware = system.deviceData.board.components.D2;


Button1.$name         = "CONFIG_BUTTON_0";
Button1.$hardware     = system.deviceData.board.components.USR_SW1;
Button1.gpioPin.$name = "CONFIG_GPIO_2";

/**
 * Pinmux solution for unlocked pins/peripherals. This ensures that minor changes to the automatic solver in a future
 * version of the tool will not impact the pinmux you originally saw.  These lines can be completely deleted in order to
 * re-solve from scratch.
 */
GPIO1.gpioPin.$suggestSolution           = "expansion.87";
GPIO2.gpioPin.$suggestSolution           = "expansion.85";
RTOS.timer0.resource.$suggestSolution    = "Timer0";
Button1.gpioPin.gpioPin.$suggestSolution = "expansion.82";
